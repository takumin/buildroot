## package/elogind/Config.in
```kconfig
config BR2_PACKAGE_ELOGIND_ARCH_SUPPORTS
	bool
	# see src/basic/architecture.h
	default y if BR2_arc
	default y if BR2_aarch64 || BR2_aarch64_be
	default y if BR2_arm || BR2_armeb
	default y if BR2_i386 || BR2_x86_64
	default y if BR2_m68k
	default y if BR2_mips || BR2_mipsel || BR2_mips64 || BR2_mips64el
	default y if BR2_powerpc || BR2_powerpc64 || BR2_powerpc64le
	default y if BR2_nios2
	default y if BR2_riscv
	default y if BR2_sh4 || BR2_sh4eb || BR2_sh4a || BR2_sh4aeb
	default y if BR2_sparc || BR2_sparc64
	default y if BR2_s390x

config BR2_PACKAGE_ELOGIND
	bool "elogind"
	depends on BR2_PACKAGE_ELOGIND_ARCH_SUPPORTS
	depends on BR2_TOOLCHAIN_GCC_AT_LEAST_5
	depends on BR2_TOOLCHAIN_HAS_SSP
	depends on BR2_TOOLCHAIN_HEADERS_AT_LEAST_5_10 # src/basic/linux/if.h:x25_hdlc_proto
	depends on BR2_TOOLCHAIN_USES_GLIBC
	depends on BR2_USE_MMU
	select BR2_PACKAGE_DBUS if !BR2_PACKAGE_DBUS_BROKER # runtime
	select BR2_PACKAGE_HAS_UDEV
	select BR2_PACKAGE_LIBCAP
	select BR2_PACKAGE_UTIL_LINUX
	select BR2_PACKAGE_UTIL_LINUX_LIBMOUNT
	select BR2_PACKAGE_UTIL_LINUX_LIBS
	select BR2_PACKAGE_UTIL_LINUX_MOUNT
	help
	  Elogind User, Seat and Session Manager.

	  Elogind is the systemd project's "logind", extracted out
	  to be a standalone daemon.

	  It integrates with PAM to know the set of users that are
	  logged in to a system and whether they are logged in
	  graphically, on the console, or remotely.

	  Elogind exposes this information via the standard
	  org.freedesktop.login1 D-Bus interface, as well as
	  through the file system using systemd's standard
	  /run/systemd layout.

	  Elogind also provides "libelogind", which is a subset
	  of the facilities offered by "libsystemd".

	  There is a "libelogind.pc" pkg-config file as well.

	  https://github.com/elogind/elogind
```

## package/gtk-doc/Config.in.host
```kconfig
config BR2_PACKAGE_HOST_GTK_DOC
	bool "host gtk-doc"
	select BR2_PACKAGE_HOST_ITSTOOL
	select BR2_PACKAGE_HOST_LIBXSLT
	select BR2_PACKAGE_HOST_PYTHON3
	select BR2_PACKAGE_HOST_PYTHON_PYGMENTS
	help
	  Documentation generator for C code.

	  https://gitlab.gnome.org/GNOME/gtk-doc
```

## package/iso-codes/Config.in
```kconfig
config BR2_PACKAGE_ISO_CODES
	bool "iso-codes"
	help
	  ISO language, territory, currency, script codes
	  and their translations.

	  https://salsa.debian.org/iso-codes-team/iso-codes
```

## package/itstool/Config.in.host
```kconfig
config BR2_PACKAGE_HOST_ITSTOOL
	bool "host itstool"
	select BR2_PACKAGE_HOST_PYTHON3
	select BR2_PACKAGE_HOST_LIBXML2
	help
	  ITS Tool allows you to translate your XML documents with
	  PO files, using rules from the W3C Internationalization
	  Tag Set (ITS) to determine what to translate and how to
	  separate it into PO file messages.

	  https://itstool.org/
```

## package/libxklavier/Config.in
```kconfig
config BR2_PACKAGE_LIBXKLAVIER
	bool "libxklavier"
	depends on BR2_PACKAGE_XORG7
	depends on BR2_USE_WCHAR # glib2
	depends on BR2_TOOLCHAIN_HAS_THREADS # glib2
	depends on BR2_USE_MMU # glib2
	select BR2_PACKAGE_ISO_CODES
	select BR2_PACKAGE_LIBGLIB2
	select BR2_PACKAGE_LIBXML2
	select BR2_PACKAGE_XLIB_LIBX11
	help
	  libxklavier is a library providing high-level API for
	  X Keyboard Extension known as XKB.

	  https://www.freedesktop.org/wiki/Software/LibXklavier/

if BR2_PACKAGE_LIBXKLAVIER

config BR2_PACKAGE_LIBXKLAVIER_XKB_SUPPORT
	bool "enable xkb support"
	default y
	select BR2_PACKAGE_XLIB_LIBXKBFILE
	help
	  Enable XKB support

config BR2_PACKAGE_LIBXKLAVIER_XMODMAP_SUPPORT
	bool "enable xmodmap support"
	default y
	select BR2_PACKAGE_XAPP_XMODMAP
	help
	  Enable xmodmap support

endif
```

## package/libxml2/Config.in.host
```kconfig
config BR2_PACKAGE_HOST_LIBXML2
	bool "host libxml2"
	help
	  XML C Parser

	  http://xmlsoft.org/
```

## package/libxslt/Config.in.host
```kconfig
config BR2_PACKAGE_HOST_LIBXSLT
	bool "host libxslt"
	select BR2_PACKAGE_HOST_LIBXML2
	help
	  Applying XSLT stylesheets to XML documents.

	  https://gitlab.gnome.org/GNOME/libxslt/-/wikis/home
```

## package/lightdm/Config.in
```kconfig
config BR2_PACKAGE_LIGHTDM
	bool "lightdm"
	depends on BR2_PACKAGE_XORG7
	depends on BR2_PACKAGE_LIBGPG_ERROR_ARCH_SUPPORTS # libgcrypt
	depends on (BR2_ENABLE_LOCALE && BR2_USE_WCHAR) # linux-pam
	depends on !BR2_STATIC_LIBS # linux-pam
	depends on BR2_USE_MMU # linux-pam
	select BR2_PACKAGE_HOST_GTK_DOC
	select BR2_PACKAGE_HOST_LIBXML2
	select BR2_PACKAGE_HOST_YELP_TOOLS
	select BR2_PACKAGE_LIBGCRYPT
	select BR2_PACKAGE_LIBGLIB2
	select BR2_PACKAGE_LIBXCB
	select BR2_PACKAGE_LIBXKLAVIER
	select BR2_PACKAGE_LINUX_PAM
	select BR2_PACKAGE_XLIB_LIBX11
	select BR2_PACKAGE_XLIB_LIBXDMCP
	help
	  LightDM is a lightweight, cross-desktop display manager.

	  https://github.com/canonical/lightdm

comment "lightdm needs a toolchain w/ wchar, locale, dynamic library"
	depends on BR2_PACKAGE_XORG7
	depends on !(BR2_ENABLE_LOCALE && BR2_USE_WCHAR) \
		|| BR2_STATIC_LIBS
```

## package/python-pygments/Config.in.host
```kconfig
config BR2_PACKAGE_HOST_PYTHON_PYGMENTS
	bool "host python-pygments"
	help
	  The host Pygments package is a syntax highlighting.

	  https://pypi.python.org/pypi/Pygments
```

## package/yelp-tools/Config.in.host
```kconfig
config BR2_PACKAGE_HOST_YELP_TOOLS
	bool "host yelp-tools"
	select BR2_PACKAGE_HOST_ITSTOOL
	select BR2_PACKAGE_HOST_LIBXML2
	select BR2_PACKAGE_HOST_LIBXSLT
	select BR2_PACKAGE_HOST_PYTHON3
	select BR2_PACKAGE_HOST_PYTHON_LXML
	select BR2_PACKAGE_HOST_YELP_XSL
	help
	  Yelp documentation tools.

	  https://wiki.gnome.org/Apps/Yelp/Tools
```

## package/yelp-xsl/Config.in.host
```kconfig
config BR2_PACKAGE_HOST_YELP_XSL
	bool "host yelp-xsl"
	select BR2_PACKAGE_HOST_ITSTOOL
	select BR2_PACKAGE_HOST_LIBXML2
	select BR2_PACKAGE_HOST_LIBXSLT
	help
	  Yelp documentation tools.

	  https://wiki.gnome.org/Apps/Yelp/Tools
```
